/*@!Encoding:1252*/
includes
{
  
}

variables
{
  
}


export testcase ctc_CheckPWMToSetpointSpeed(){
  int speed = 1000;
  int expectedPWM = 9362;
  
  testStep("1.0", "Set Speed = %d", speed);
  setSignal(Comfort::Signal_Fan_Speed, speed);
  testStep("2.0", "Check if PWM is set as expected");
  cf_assertExitNotForTimeout(TestWaitForSignalMatch(sysvarMember::VTT::Fan_ECU::Pwm::PWM_FanMotor.value, expectedPWM, syspar::sourceCodeIterationTime));
  cf_assertValueEq(expectedPWM, @sysvarMember::VTT::Fan_ECU::Pwm::PWM_FanMotor.value, "Check PWM value");
}


export testcase ctc_CheckCycleTime(){
  dword checkId;
  testStep("1.0", "Check Cyclic Time");
  checkId = ChkStart_MsgAbsCycleTimeViolation(Comfort::Comfort_Fan_Frame_PDU, 998, 1002);
  TestAddCondition(checkId);
  TestWaitForTimeout(syspar::sourceCodeIterationTime);
  TestRemoveCondition(checkId);
  ChkControl_Stop(checkId);
}


export testcase ctc_CheckDrivingCycleInformation() {
  int speed = 2330;
  int expectedPwm = 21814;
  
  testStep("1.0", "Stop Driving Cycle and Set Speed");
  setSignal(Comfort::Signal_DrivingCycle,0);
  setSignal(Comfort::Signal_Fan_Speed,speed);
  
  testStep("1.1", "Expect no actuation of PWM");
  testWaitForTimeout(syspar::sourceCodeIterationTime);
  cf_assertValueEq(0, @sysvarMember::VTT::Fan_ECU::Pwm::PWM_FanMotor.value, "Check PWM value");
  
  testStep("2.0", "Start Driving Cycle");
  setSignal(Comfort::Signal_DrivingCycle,1);
  
  testStep("2.1", "Expect PWM to be actuated");
  cf_assertExitNotForTimeout(TestWaitForSignalMatch(sysvarMember::VTT::Fan_ECU::Pwm::PWM_FanMotor.value, expectedPwm, syspar::sourceCodeIterationTime));
  cf_assertValueEq(expectedPwm, @sysvarMember::VTT::Fan_ECU::Pwm::PWM_FanMotor.value, "Check PWM value");
  
  testStep("3.0", "Cause Fault in Motor");
  @sysvar::TestInterface::HighCurrent = 1;
  
  testStep("3.1", "Expect no actuation of PWM and active Fault Signal");
  testWaitForTimeout(syspar::sourceCodeIterationTime);
  cf_assertValueEq(0, @sysvarMember::VTT::Fan_ECU::Pwm::PWM_FanMotor.value, "Check PWM value");
  cf_assertExitNotForTimeout(TestWaitForSignalMatch(Comfort::Signal_Fan_Fault, 1, syspar::sourceCodeIterationTime));
  cf_assertValueEq(1, getSignal(Comfort::Signal_Fan_Fault), "Check Fault signal is set"); 
  
  testStep("4.0", "Stop Driving Cycle");
  setSignal(Comfort::Signal_DrivingCycle,0);
  
  testStep("4.1", "Expect no actuation of PWM and Fault Signal inactive");
  testWaitForTimeout(syspar::sourceCodeIterationTime);
  cf_assertValueEq(0, @sysvarMember::VTT::Fan_ECU::Pwm::PWM_FanMotor.value, "Check PWM value");
  cf_assertExitNotForTimeout(TestWaitForSignalMatch(Comfort::Signal_Fan_Fault, 0, syspar::sourceCodeIterationTime));
  cf_assertValueEq(0, getSignal(Comfort::Signal_Fan_Fault), "Check Fault signal is not set"); 
}


export testcase ctc_MotorCurrentDrawObservation() {
  int speed = 1500;
  int expectedPwm = 14043;
  int expectedAdc = 2.25;
  
  testStep("1.0", "Check Normal Operation");
  
  testStep("1.1", "Set Speed = %d", speed);
  setSignal(Comfort::Signal_Fan_Speed, speed);
  testWaitForTimeout(syspar::sourceCodeIterationTime);
  
  testStep("1.2", "Check Fault Signal, PWM and ADC");
  cf_assertExitNotForTimeout(TestWaitForSignalMatch(Comfort::Signal_Fan_Fault, 0, syspar::sourceCodeIterationTime));
  cf_assertValueEq(0, getSignal(Comfort::Signal_Fan_Fault), "Check Fault signal not set"); 
  
  cf_assertExitNotForTimeout(TestWaitForSignalMatch(sysvarMember::VTT::Fan_ECU::Pwm::PWM_FanMotor.value, expectedPwm, syspar::sourceCodeIterationTime));
  cf_assertValueEq(expectedPwm, @sysvarMember::VTT::Fan_ECU::Pwm::PWM_FanMotor.value, "Check PWM value");
  
  cf_assertValueEq(expectedAdc, @sysvar::VTT::Fan_ECU::Adc::AdcPower, "Check ADC value");
  
  
  testStep("2.0", "Check Faulty Operation (short circuit)");
  
  expectedPwm = 0;
  expectedAdc = 0;
  
  testStep("2.1", "Cause a Short Circuit");
  @sysvar::TestInterface::ShortCircuit = 1;
  testWaitForTimeout(syspar::sourceCodeIterationTime);
  
  testStep("2.2", "Check Reaction to changed ADC: Fault Signal and PWM");
  cf_assertExitNotForTimeout(TestWaitForSignalMatch(Comfort::Signal_Fan_Fault, 1, syspar::sourceCodeIterationTime));
  cf_assertValueEq(1, getSignal(Comfort::Signal_Fan_Fault), "Check Fault signal set"); 
  
  cf_assertExitNotForTimeout(TestWaitForSignalMatch(sysvarMember::VTT::Fan_ECU::Pwm::PWM_FanMotor.value, expectedPwm, syspar::sourceCodeIterationTime));
  cf_assertValueEq(expectedPwm, @sysvarMember::VTT::Fan_ECU::Pwm::PWM_FanMotor.value, "Check PWM value");
  
  cf_assertValueEq(expectedAdc, @sysvar::VTT::Fan_ECU::Adc::AdcPower, "Check ADC value");
}