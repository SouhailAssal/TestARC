/*@!Encoding:1252*/
includes
{
  
}

variables
{
  
}


export void cf_assertExitNotForTimeout(long returncode) {
  char buffer[256];
  if (returncode == 0) {
    testStepFail("Timeout occured, expected value not seen.");
  } else if (returncode == 1) {
    testStepPass("linSetExpectedRespLength value seen before timeout");
  } else {
    snprintf(buffer, 255, "Other error occured: Returncode %d", returncode);
    testStepFail(buffer);
  }
}

export void cf_expectValueEq(long expected, long actual, char description[]) {
  char buffer[256];
  
  snprintf(buffer, 255, "%s. Expected: %d, Actual: %d", description, expected, actual);
  
  if (expected != actual) {
    testStepFail(buffer);
  }
}

export void cf_expectValueNe(long expected, long actual, char description[]) {
  char buffer[256];
  
  snprintf(buffer, 255, "%s. Not Expected: %d, Actual: %d", description, expected, actual);
  
  if (expected == actual) {
    testStepFail(buffer);
  }
}

export void cf_expectValueGteq(long expected, long actual, char description[]) {
  char buffer[256];
  
  snprintf(buffer, 255, "%s. Not Expected: %d, Actual: %d", description, expected, actual);
  
  if (actual < expected) {
    testStepFail(buffer);
  }
}

export void cf_assertValueEq(long expected, long actual, char description[]) {
  char buffer[256];
  
  snprintf(buffer, 255, "%s. Expected: %d, Actual: %d", description, expected, actual);
  
  if (expected == actual) {
    testStepPass(buffer);
  } else {
    testStepFail(buffer);
  }
}

export void cf_assertValueNe(long expected, long actual, char description[]) {
  char buffer[256];
  
  snprintf(buffer, 255, "%s. Not Expected: %d, Actual: %d", description, expected, actual);
  
  if (expected != actual) {
    testStepPass(buffer);
  } else {
    testStepFail(buffer);
  }
}