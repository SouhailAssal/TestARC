/*@!Encoding:1252*/
includes
{
  
}

variables
{
  const cAccessModePhysical=1;
  const int diagTimeout = 10000;
}

export void cf_InitState() {
  // Set a valid speed signal value
  setSignal(Comfort::Signal_Fan_Speed, 1750);
  // reset test variables
  @sysvar::TestInterface::OpenLoop = 0;
  @sysvar::TestInterface::ShortCircuit = 0;
  @sysvar::TestInterface::HighCurrent = 0;
  @sysvar::TestInterface::LowCurrent = 0;
  testWaitForTimeout(syspar::sourceCodeIterationTime + 1000); // Give ECU more time to return to valid state
}

export void cf_CheckFailedPreconditon() {
  cf_expectValueNe(1, @sysvar::TestInterface::OpenLoop,  "The system is in an Open Loop state!");
  cf_expectValueNe(1, @sysvar::TestInterface::ShortCircuit,  "The system is in an Short Circuit state!");
  cf_expectValueNe(1, @sysvar::TestInterface::HighCurrent,  "High Current detected!");
  cf_expectValueNe(1, @sysvar::TestInterface::LowCurrent,  "Low Current detected!");
  cf_expectValueNe(1, getSignal(Comfort::Signal_Fan_Fault),  "Fault signal is active!");
}

export void cf_ClearFaultMemory() {
  diagRequest FanControl_ECU.FaultMemory_Clear request;
  diagResponse FanControl_ECU.FaultMemory_Clear response;
  
  long diagResponseValue;
  
  cf_expectValueEq(0, request.SendRequest(), "Sending Diagnostic Request");
  cf_assertValueEq(1, testWaitForDiagRequestSent(request, diagTimeout), "Waiting for Diagnostic Request Transmission");
  cf_assertValueEq(1, testWaitForDiagResponse(request, diagTimeout), "Waiting for Diagnostic Response Reception");
  cf_assertValueEq(-1, diagGetLastResponseCode(request), "Positive Response expected");
}

export void cf_ResetDrivingCycle(){
  cf_RestartDrivingCycle();
  setSignal(Comfort::Signal_DrivingCycle, 0);
}

export void cf_RestartDrivingCycle(){
  setSignal(Comfort::Signal_DrivingCycle, 0);
  testWaitForTimeout(syspar::sourceCodeIterationTime);
  setSignal(Comfort::Signal_DrivingCycle, 1);
  testWaitForTimeout(syspar::sourceCodeIterationTime);
}