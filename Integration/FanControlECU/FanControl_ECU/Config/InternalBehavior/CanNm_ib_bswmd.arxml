AUTOSAR XML (schema 00050)
package /MICROSAR
  bsw implementation CanNm_Impl: programming-language=C, sw-version=11.00.01, used-code-generator=DaVinci Configurator, vendor-id=30, ar-release-version=4.00.03
package /MICROSAR/CanNm_ib_bswmd/BswModuleDescriptions
  bsw module description CanNm: provided-entrys=CanNm_MainFunction
    bsw internal behavior CanNmBehavior
      8 x exclusive area:
        CANNM_EXCLUSIVE_AREA_0  # No interruption by any interrupt allowed (i.e. global interrupt locks).
        CANNM_EXCLUSIVE_AREA_1  # No interruption of CanNm_MainFunction or CanNm_RequestBusSynchronization by CanNm_SetUserData or CanNm_SetSleepReadyBit allowed.
        CANNM_EXCLUSIVE_AREA_2  # No interruption of CanNm_SetUserData by CanNm_MainFunction or CanNm_RequestBusSynchronization allowed.
        CANNM_EXCLUSIVE_AREA_3  # No interruption of CanNm_SetSleepReadyBit by CanNm_MainFunction or CanNm_RequestBusSynchronization allowed.
        CANNM_EXCLUSIVE_AREA_4  # No interruption of CanNm_RxIndication by CanNm_GetUserData or CanNm_GetPduData allowed.
        CANNM_EXCLUSIVE_AREA_5  # No interruption of CanNm_GetUserData or CanNm_GetPduData by CanNm_RxIndication allowed.
        CANNM_EXCLUSIVE_AREA_6  # No interruption of CanNm_MainFunction by CanNm_RequestBusSynchronization allowed. Note: This critical section can be left empty when CanNm_MainFunction and Nm_MainFunction have the same task.
        CANNM_EXCLUSIVE_AREA_7  # No interruption of CanNm_MainFunction by CanNm_RequestSynchronizedPncShutdown allowed.
      bsw schedulable entity CanNm_MainFunction: can-enter-exclusive-area=[CANNM_EXCLUSIVE_AREA_0, CANNM_EXCLUSIVE_AREA_1, CANNM_EXCLUSIVE_AREA_2, CANNM_EXCLUSIVE_AREA_3, CANNM_EXCLUSIVE_AREA_4, CANNM_EXCLUSIVE_AREA_5, CANNM_EXCLUSIVE_AREA_6, CANNM_EXCLUSIVE_AREA_7], implemented-entry=CanNm_MainFunction
      bsw timing event CanNm_MainFunctionTimingEvent0: starts-on-event=CanNm_MainFunction, period=0.01
  bsw module entry CanNm_MainFunction: call-type=SCHEDULED, execution-context=TASK
