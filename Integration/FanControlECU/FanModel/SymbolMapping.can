/*@!Encoding:1252*/
includes
{
  
}

variables
{
  
}

on sysvar_update sysvar::TestInterface::mapped_AdcPower
{
  @sysvar::VTT::Fan_ECU::Adc::AdcPower = @sysvar::TestInterface::mapped_AdcPower;
}

on signal_update(Comfort::Signal_DrivingCycle) 
{
  @sysvar::TestInterface::mapped_DrivingCycle = getSignal(Comfort::Signal_DrivingCycle);
}

on sysvar_update sysvarMember::VTT::Fan_ECU::Pwm::PWM_FanMotor.dutyCycle
{
  @sysvar::TestInterface::mapped_PwmDutyCycle = @sysvarMember::VTT::Fan_ECU::Pwm::PWM_FanMotor.dutyCycle.phys;
}