/*@!Encoding:1252*/
includes
{
}

variables
{
  const float powerMinValidValue = 0.25;
  const float powerMaxValidValue = 4.75;
  msTimer FanTimer;
  float powerADC = 0.0;
  int dutyCycle = 0;
}

on start
{

}

float computeAdcPower(int dutyCycle) {
  return ((dutyCycle * powerMaxValidValue) / 100) + powerMinValidValue;
}

on sysvar_update(sysvar::TestInterface::mapped_PwmDutyCycle |
                 sysvar::TestInterface::ShortCircuit |
                 sysvar::TestInterface::OpenLoop |
                 sysvar::TestInterface::HighCurrent |
                 sysvar::TestInterface::LowCurrent) 
{
  // EDSG-00030: The fan model takes the PWM ratio as an input from the Fan ECU.
  dutyCycle = @sysvar::TestInterface::mapped_PwmDutyCycle;
  
  if (dutyCycle == 0) {
    powerADC = 0;
  } else if (@sysvar::TestInterface::ShortCircuit) {
    powerADC = 6;
  } else if (@sysvar::TestInterface::OpenLoop) {
    powerADC = 0.20;
  } else if (@sysvar::TestInterface::HighCurrent) {
    powerADC = computeAdcPower(dutyCycle) * 0.9; // -10%
  } else if (@sysvar::TestInterface::LowCurrent) {
    powerADC = computeAdcPower(dutyCycle) * 1.1; // +10%
  } else {
    powerADC = computeAdcPower(dutyCycle);
  }

  // EDSG-00033: The fan model provides the current motor current to the Fan ECU.
  @sysvar::TestInterface::mapped_AdcPower = powerADC;
}
